## example/07-magnetic_reed_switch(KY-025)/Kconfig
```kconfig
config QAPP_KY025_ADC_DEMO
    bool "KY-025 magnetic reed switch ADC demo"
    default n
```

## example/08-Obstacle_Detection_Module(KY-032)/ky032_demps/Kconfig
```kconfig
config QAPP_KY032_DEMO
    bool "KY-032 obstacle avoidance demo"
    default n

if QAPP_KY032_DEMO

config QAPP_KY032_PIN_NUM
    int "KY-032 digital output pin number"
    range 0 127
    default 23

config QAPP_KY032_ACTIVE_LEVEL
    int "KY-032 obstacle active level"
    range 0 1
    default 0

config QAPP_KY032_SAMPLE_PERIOD_MS
    int "KY-032 sample period (ms)"
    range 20 5000
    default 100

config QAPP_KY032_USE_INTERRUPT
	bool "Use GPIO interrupt mode"
	default n

endif
```

## example/12-Magic_Aura_Module(KY-027)/Kconfig
```kconfig
config QAPP_TILT_SWITCH_DEMO
    bool "Tilt switch linked output demo"
    default n
```

## example/17-Laser_emission_module(KY-008)/Kconfig
```kconfig
menu "KY008 laser transmitter demo"

config QAPP_KY008_DEMO
    bool "KY008 laser transmitter demo"
    default n

if QAPP_KY008_DEMO

config QAPP_KY008_PIN_NUM
    int "KY008 signal pin number"
    range 1 105
    default 31
    help
        Physical pin connected to the KY008 signal input. Change this value
        according to the board schematic or wiring.

config QAPP_KY008_ACTIVE_LEVEL
    int "Laser active level"
    range 0 1
    default 1
    help
        1 means the laser turns on when the GPIO outputs high level.
        0 means the laser turns on when the GPIO outputs low level.

config QAPP_KY008_INTERVAL_MS
    int "Laser blink interval in milliseconds"
    range 1 60000
    default 2000
    help
        The demo keeps blinking forever. This value is used for both the on
        duration and the off duration of each blink cycle.

endif

endmenu
```

## example/19-temperature_and_humidity_sensor(AHT20)/Kconfig
```kconfig
config QAPP_AHT20_DEMO
    bool "AHT20 temperature and humidity demo"
    select QOSA_IIC_FUNC
    select QOSA_PINCTRL_FUNC
    default n
```
